## firmware/aether-light/components/board_hal/Kconfig
```kconfig
menu "Aether Light board hardware"

    if IDF_TARGET_ESP32P4
        rsource "Kconfig.esp32p4"
    endif

    if IDF_TARGET_ESP32S31
        rsource "Kconfig.esp32s31"
    endif

endmenu
```

## firmware/aether-light/components/board_hal/Kconfig.esp32p4
```kconfig
menu "ESP32-P4-Function-EV-Board"

    config AETHER_HAL_P4_ETH_PHY_ADDR
        int "IP101 PHY address"
        range 0 31
        default 1

    config AETHER_HAL_P4_ETH_MDC_GPIO
        int "Ethernet MDC GPIO"
        default 31

    config AETHER_HAL_P4_ETH_MDIO_GPIO
        int "Ethernet MDIO GPIO"
        default 52

    config AETHER_HAL_P4_ETH_PHY_RST_GPIO
        int "Ethernet PHY reset GPIO"
        default 51

    config AETHER_HAL_P4_ETH_RMII_TX_EN_GPIO
        int "RMII TX_EN GPIO"
        default 49

    config AETHER_HAL_P4_ETH_RMII_TXD0_GPIO
        int "RMII TXD0 GPIO"
        default 34

    config AETHER_HAL_P4_ETH_RMII_TXD1_GPIO
        int "RMII TXD1 GPIO"
        default 35

    config AETHER_HAL_P4_ETH_RMII_CRS_DV_GPIO
        int "RMII CRS_DV GPIO"
        default 28

    config AETHER_HAL_P4_ETH_RMII_RXD0_GPIO
        int "RMII RXD0 GPIO"
        default 29

    config AETHER_HAL_P4_ETH_RMII_RXD1_GPIO
        int "RMII RXD1 GPIO"
        default 30

    config AETHER_HAL_P4_ETH_RMII_CLK_GPIO
        int "RMII REF_CLK input GPIO"
        default 50

    config AETHER_HAL_P4_LED_GPIO_0
        int "LED channel 1 GPIO"
        default 2

    config AETHER_HAL_P4_LED_GPIO_1
        int "LED channel 2 GPIO"
        default 3

    config AETHER_HAL_P4_LED_GPIO_2
        int "LED channel 3 GPIO"
        default 4

    config AETHER_HAL_P4_LED_GPIO_3
        int "LED channel 4 GPIO"
        default 5

    config AETHER_HAL_P4_LED_GPIO_4
        int "LED channel 5 GPIO"
        default 6

    config AETHER_HAL_P4_LED_GPIO_5
        int "LED channel 6 GPIO"
        default 21

    config AETHER_HAL_P4_LED_GPIO_6
        int "LED channel 7 GPIO"
        default 22

    config AETHER_HAL_P4_LED_GPIO_7
        int "LED channel 8 GPIO"
        default 32

    config AETHER_HAL_P4_LED_GPIO_8
        int "LED channel 9 GPIO"
        default 14

    config AETHER_HAL_P4_LED_GPIO_9
        int "LED channel 10 GPIO"
        default 15

    config AETHER_HAL_P4_LED_GPIO_10
        int "LED channel 11 GPIO"
        default 16

    config AETHER_HAL_P4_LED_GPIO_11
        int "LED channel 12 GPIO"
        default 17

    config AETHER_HAL_P4_LED_GPIO_12
        int "LED channel 13 GPIO"
        default 18

    config AETHER_HAL_P4_LED_GPIO_13
        int "LED channel 14 GPIO"
        default 24

    config AETHER_HAL_P4_LED_GPIO_14
        int "LED channel 15 GPIO"
        default 25

    config AETHER_HAL_P4_LED_GPIO_15
        int "LED channel 16 GPIO"
        default 33

endmenu
```

## firmware/aether-light/components/board_hal/Kconfig.esp32s31
```kconfig
menu "ESP32-S31-Function-CoreBoard-1"

    config AETHER_HAL_S31_ETH_PHY_ADDR
        int "YT8531 PHY address (-1 for auto-detect)"
        range -1 31
        default -1

    config AETHER_HAL_S31_ETH_MDC_GPIO
        int "Ethernet MDC GPIO"
        default 5

    config AETHER_HAL_S31_ETH_MDIO_GPIO
        int "Ethernet MDIO GPIO"
        default 6

    config AETHER_HAL_S31_ETH_PHY_RST_GPIO
        int "Ethernet PHY reset GPIO"
        default 7

    config AETHER_HAL_S31_ETH_RGMII_TXD0_GPIO
        int "RGMII TXD0 GPIO"
        default 8

    config AETHER_HAL_S31_ETH_RGMII_TXD1_GPIO
        int "RGMII TXD1 GPIO"
        default 9

    config AETHER_HAL_S31_ETH_RGMII_TXD2_GPIO
        int "RGMII TXD2 GPIO"
        default 10

    config AETHER_HAL_S31_ETH_RGMII_TXD3_GPIO
        int "RGMII TXD3 GPIO"
        default 11

    config AETHER_HAL_S31_ETH_RGMII_TX_CTL_GPIO
        int "RGMII TX_CTL GPIO"
        default 12

    config AETHER_HAL_S31_ETH_RGMII_TX_CLK_GPIO
        int "RGMII TX_CLK GPIO"
        default 13

    config AETHER_HAL_S31_ETH_RGMII_RX_CLK_GPIO
        int "RGMII RX_CLK GPIO"
        default 14

    config AETHER_HAL_S31_ETH_RGMII_RX_CTL_GPIO
        int "RGMII RX_CTL GPIO"
        default 15

    config AETHER_HAL_S31_ETH_RGMII_RXD3_GPIO
        int "RGMII RXD3 GPIO"
        default 16

    config AETHER_HAL_S31_ETH_RGMII_RXD2_GPIO
        int "RGMII RXD2 GPIO"
        default 17

    config AETHER_HAL_S31_ETH_RGMII_RXD1_GPIO
        int "RGMII RXD1 GPIO"
        default 18

    config AETHER_HAL_S31_ETH_RGMII_RXD0_GPIO
        int "RGMII RXD0 GPIO"
        default 19

    config AETHER_HAL_S31_LED_GPIO_0
        int "LED channel 1 GPIO"
        default 2

    config AETHER_HAL_S31_LED_GPIO_1
        int "LED channel 2 GPIO"
        default 3

    config AETHER_HAL_S31_LED_GPIO_2
        int "LED channel 3 GPIO"
        default 4

    config AETHER_HAL_S31_LED_GPIO_3
        int "LED channel 4 GPIO"
        default 35

    config AETHER_HAL_S31_LED_GPIO_4
        int "LED channel 5 GPIO"
        default 36

    config AETHER_HAL_S31_LED_GPIO_5
        int "LED channel 6 GPIO"
        default 37

    config AETHER_HAL_S31_LED_GPIO_6
        int "LED channel 7 GPIO"
        default 38

    config AETHER_HAL_S31_LED_GPIO_7
        int "LED channel 8 GPIO"
        default 39

    config AETHER_HAL_S31_LED_GPIO_8
        int "LED channel 9 GPIO"
        default 26

    config AETHER_HAL_S31_LED_GPIO_9
        int "LED channel 10 GPIO"
        default 27

    config AETHER_HAL_S31_LED_GPIO_10
        int "LED channel 11 GPIO"
        default 28

    config AETHER_HAL_S31_LED_GPIO_11
        int "LED channel 12 GPIO"
        default 30

    config AETHER_HAL_S31_LED_GPIO_12
        int "LED channel 13 GPIO"
        default 31

    config AETHER_HAL_S31_LED_GPIO_13
        int "LED channel 14 GPIO"
        default 32

    config AETHER_HAL_S31_LED_GPIO_14
        int "LED channel 15 GPIO"
        default 33

    config AETHER_HAL_S31_LED_GPIO_15
        int "LED channel 16 GPIO"
        default 34

endmenu
```

## firmware/aether-light/components/network_manager/Kconfig
```kconfig
menu "Network Manager"

    menu "Ethernet policy"

        config NETWORK_MANAGER_ETH_CONNECT_TIMEOUT_MS
            int "Time to wait for Ethernet to get an IP before falling back to WiFi (ms)"
            default 10000

    endmenu

    menu "WiFi Fallback"

        config NETWORK_MANAGER_WIFI_MAX_RETRY
            int "Maximum WiFi connection retries before giving up"
            default 5

        config NETWORK_MANAGER_WIFI_DEFAULT_SSID
            string "Default WiFi SSID (used only when none is stored in NVS yet)"
            default ""

        config NETWORK_MANAGER_WIFI_DEFAULT_PASSWORD
            string "Default WiFi password (used only when none is stored in NVS yet)"
            default ""

    endmenu

endmenu
```

## firmware/aether-light/sdkconfig.defaults.esp32s31
```kconfig
# ESP32-S31-Function-CoreBoard-1 (ESP32-S31-WROOM-3-N16R16V).
CONFIG_IDF_TARGET="esp32s31"
CONFIG_ESPTOOLPY_FLASHSIZE_16MB=y
CONFIG_ESPTOOLPY_FLASHSIZE="16MB"
CONFIG_SPIRAM=y
CONFIG_SPIRAM_MODE_OCT=y
CONFIG_SPIRAM_SPEED_250M=y
CONFIG_ETH_ENABLED=y
CONFIG_ETH_USE_ESP32_EMAC=y
```
